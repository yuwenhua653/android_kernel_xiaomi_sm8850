## drivers/power/supply/mca/mca_hardware_ic/wireless_ic/sc96281/Kconfig
```kconfig
# SPDX-License-Identifier: GPL-2.0-only
config MCA_EXTERNAL_WIRELESS_SC96281
	tristate "Xiaomi SC96281 wireless receiver"
	depends on I2C && OF && GPIOLIB
	depends on XIAOMI_MCA_CLASSES && XIAOMI_MCA_STRATEGY_CLASS && XIAOMI_MCA_ADSP_PD
	select REGMAP_I2C
	help
	  SC96281 receiver using board dual Hall GPIOs and six-column FOD data.
	  Uses resident IC firmware; contains no firmware programming payload.
```

## drivers/xiaomi/Kconfig
```kconfig
# SPDX-License-Identifier: GPL-2.0-only
config XIAOMI_NEZHA_IR_SPI
	tristate "Xiaomi Nezha SPI infrared transmitter"
	depends on SPI && OF
	help
	  Exposes the consumer infrared transmit interface used by the Nezha HAL.

config STMVL53L5
	tristate "ST VL53L5/L8 SPI ranging sensor on Nezha"
	depends on SPI && OF && REGULATOR
	select FW_LOADER
	help
	  Selects the ranging sensor used with the Nezha camera HAL.
```
